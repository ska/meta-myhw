## conf/layer.conf
```bitbake
# We have a conf and classes directory, append to BBPATH
BBPATH .= ":${LAYERDIR}"

# We have recipes-* directories, add to BBFILES
BBFILES += "${LAYERDIR}/recipes-*/*/*.bb \
            ${LAYERDIR}/recipes-*/*/*.bbappend"

BBFILE_COLLECTIONS += "myhw"
BBFILE_PATTERN_myhw := "^${LAYERDIR}/"
BBFILE_PRIORITY_myhw = "7"

LAYERSERIES_COMPAT_myhw = "scarthgap styhead"

# This should only be incremented on significant changes that will
# cause compatibility issues with other layers
LAYERVERSION_myhw = "1"
```

## conf/machine/kirkwood-goflexnet.conf
```bitbake
#@TYPE: Machine
#@NAME: Seagate GoFlex Net
#@DESCRIPTION: Machine configuration for Seagate GoFlex Net

require conf/machine/include/arm/armv5/tune-xscale.inc

PREFERRED_PROVIDER_virtual/bootloader = "u-boot-kirkwood"
UBOOT_MACHINE = "goflexhome_defconfig"
UBOOT_ENTRYPOINT = "0x00008000"

PREFERRED_PROVIDER_virtual/kernel = "linux-kirkwood"
KERNEL_IMAGETYPE = "zImage"
KERNEL_DEVICETREE = "marvell/kirkwood-goflexnet.dtb"
KERNEL_APPEND_DEVICETREE = "1"

SERIAL_CONSOLES ?= "115200;ttyS0"

MACHINE_EXTRA_RRECOMMENDS += "kernel-modules "

IMAGE_FSTYPES ?= "tar.bz2"

MACHINE_FEATURES:remove = "bluetooth"
MACHINE_FEATURES:remove = " wifi"
```
